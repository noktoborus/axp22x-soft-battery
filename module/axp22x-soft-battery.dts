// SPDX-License-Identifier: GPL-2.0
/*
 * The settings and the model of axp22x_soft_battery (D106, D111): the
 * module has no default of its own, each value is here, in two nodes of
 * its own at the root. The module finds axp22x-soft-battery by its
 * compatible; no path of the PMIC, so the overlay is the same on each
 * device with an AXP22x. In config.txt after the overlay of the device:
 *
 *	dtoverlay=clockworkpi-uconsole-cm5
 *	dtoverlay=axp22x-soft-battery
 *
 * The overlay of `axp22x-soft-battery gen-dts` comes after this one.
 * battery@0 of the overlay of the device is not read.
 */

/dts-v1/;
/plugin/;

/ {
	compatible = "brcm,bcm2835";

	fragment@0 {
		target-path = "/";
		__overlay__ {
			axp22x_soft_battery: axp22x-soft-battery {
				compatible = "axp22x-soft-battery";
				monitored-battery = <&axp22x_soft_battery_cells>;

				axp22x-soft-battery,energy-full-microwatt-hours = <24790000>;
				axp22x-soft-battery,end-microvolt = <3200000>;
				axp22x-soft-battery,sample-interval-ms = <10000>;
				axp22x-soft-battery,full-margin-microvolt = <50000>;
				axp22x-soft-battery,full-current-microamp = <100000>;
				axp22x-soft-battery,silent-samples = <6>;
				axp22x-soft-battery,guard-samples = <12>;
				/* The writes of axp20x_battery of Rex (patch 0001):
				 * <reg mask value>, by regmap_update_bits() (D105).
				 */
				axp22x-soft-battery,reg-writes =
					<0x30 0x03 0x03>,	/* VBUS: no current limit */
					<0x32 0x08 0x08>,	/* CHGLED by the charger */
					<0x34 0x30 0x20>,	/* the output on after the charge; CHGLED type A */
					<0x36 0x0f 0x0b>,	/* the power key: 10 s, off, no start again */
					<0x90 0x07 0x00>;	/* GPIO0: output low */
			};

			axp22x_soft_battery_cells: axp22x-soft-battery-cells {
				compatible = "simple-battery";
				/* The design of battery@0 of the overlay of the
				 * device: 2 x 3350 mAh x 3.7 V.
				 */
				device-chemistry = "lithium-ion";
				constant-charge-current-max-microamp = <2100000>;
				voltage-max-design-microvolt = <4200000>;
				voltage-min-design-microvolt = <2900000>;
				energy-full-design-microwatt-hours = <24790000>;
				/* The mean of the three logs to the silence, R 87 mOhm
				 * (tools/make-curve.py, D59); the PMIC at 24 C in the
				 * one log that has its temperature.
				 */
				ocv-capacity-celsius = <24>;
				ocv-capacity-table-0 =
					<4221000 100>, <4119000 95>, <4093000 90>, <4084000 85>,
					<4075000 80>, <4064000 75>, <4035000 70>, <3988000 65>,
					<3934000 60>, <3897000 55>, <3868000 50>, <3837000 45>,
					<3799000 40>, <3760000 35>, <3716000 30>, <3664000 25>,
					<3608000 20>, <3554000 15>, <3499000 10>, <3437000 5>,
					<3351000 0>;
				factory-internal-resistance-micro-ohms = <87000>;
			};
		};
	};
};
